## west.yml
```yaml
manifest:
  version: 0.13.0

  remotes:
    - name: zmk
      url-base: https://github.com/zmkfirmware
    - name: tamanegi
      url-base: https://github.com/Tamanegi-51

  projects:
    - name: zmk
      remote: tamanegi
      revision: main
      path: zmk

    - name: zmk-config-lhp24lite
      remote: tamanegi
      revision: main
      path: zmk-config-lhp24lite

  self:
    path: zmk-config-lhp24lite
```

## zmk-config/west.yml
```yaml
manifest:
  remotes:
    - name: zmkfirmware
      url-base: https://github.com/zmkfirmware
    - name: tamanegi
      url-base: https://github.com/Tamanegi-51
  projects:
    - name: zmk
      remote: zmkfirmware
      revision: main
    - name: config
      remote: tamanegi
      revision: main
      path: zmk-config-lhp24lite
  self:
    path: zmk

# Trigger build again
```
